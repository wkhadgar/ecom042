## boards/edge/sua_placa/Kconfig
```kconfig
menu "Sua Placa Sub-menu"
    config SUA_PLACA_MENU_EXAMPLE_SUBMENU
        int "Configuração especifica do submenu da sua placa."
        default 10
endmenu

config SUA_PLACA_MENU_EXAMPLE
        int "Configuração especifica da sua placa."
        default 100
```

## boards/edge/sua_placa/Kconfig.sua_placa
```kconfig
config BOARD_EFR32BG22_EDGE_SUA_PLACA
    bool
	select SOC_PART_NUMBER_EFR32BG22C224F512IM40
	default y
```

## boards/edge/sua_placa/board.yml
```yaml
# SPDX-License-Identifier: Apache-2.0
#
# Copyright (c) 2024, Centro de Inovacao EDGE

board:
  name: sua_placa
  vendor: edge
  socs:
    - name: efr32bg22c224f512im40
  revision:
    format: custom
    revisions:
      - name: "p1"
      - name: "p2"
    default: "p2"
```

## boards/edge/sua_placa/sua_placa_defconfig
```kconfig
CONFIG_GPIO=y
CONFIG_SYS_CLOCK_HW_CYCLES_PER_SEC=76800000
CONFIG_SYS_CLOCK_TICKS_PER_SEC=1024
CONFIG_SOC_GECKO_EMU_DCDC=y
CONFIG_SOC_GECKO_EMU_DCDC_MODE_ON=n
CONFIG_ARM_MPU=y
CONFIG_HW_STACK_PROTECTION=y
CONFIG_CMU_HFCLK_HFRCO=y
CONFIG_PINCTRL=y
```

## camera_service/Kconfig.camera_service
```kconfig
menu "Camera service support"
config CAMERA_SERVICE
    bool "Camera service"
    default y
    select ZBUS
    select ZBUS_MSG_SUBSCRIBER
    select TEST_RANDOM_GENERATOR

if CAMERA_SERVICE

config QEMU_ICOUNT
    bool
    default n

config RADAR_CAMERA_FAILURE_RATE_PERCENT
    int "Simulated Camera Failure Rate (%)"
    range 0 100
    default 10
    help
      Chance of the simulated camera returning an 'Invalid Plate' error upon trigger.

endif

endmenu
```

## tests/integration/testcase.yaml
```yaml
tests:
  radar.integration:
    tags: radar integration
    platform_allow:
      - mps2/an385
```

## tests/unit/testcase.yaml
```yaml
tests:
  radar.unit:
    tags: radar unit
    platform_allow:
      - mps2/an385
```
